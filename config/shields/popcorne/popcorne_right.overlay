#include "popcorne.dtsi"

&default_transform { // Offset of 5 because the left side has 5 columns
    col-offset = <5>;
};

&kscan0 {
    col-gpios
        = <&pro_micro 6 GPIO_ACTIVE_HIGH>
        , <&pro_micro 5 GPIO_ACTIVE_HIGH>
        , <&pro_micro 4 GPIO_ACTIVE_HIGH>
        , <&pro_micro 3 GPIO_ACTIVE_HIGH>
        , <&pro_micro 2 GPIO_ACTIVE_HIGH>
        ;
};
