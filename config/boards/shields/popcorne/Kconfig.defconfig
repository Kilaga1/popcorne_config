## config/boards/shields/popcorne/Kconfig.defconfig
```kconfig
if SHIELD_POPCORNE_LEFT

# Name must be less than 16 characters long!
config ZMK_KEYBOARD_NAME
    default "Popcorne"

config ZMK_SPLIT_ROLE_CENTRAL
    default y

config ZMK_SLEEP
    default y

config ZMK_IDLE_SLEEP_TIMEOUT
    default 600000

endif


if SHIELD_POPCORNE_LEFT || SHIELD_POPCORNE_RIGHT

config ZMK_SPLIT
    default y

endif
```

## config/shields/popcorne/Kconfig.defconfig
```kconfig
if SHIELD_POPCORNE_LEFT

# Name must be less than 16 characters long!
config ZMK_KEYBOARD_NAME
    default "Popcorne"

config ZMK_SPLIT_ROLE_CENTRAL
    default y

endif

if SHIELD_POPCORNE_LEFT || SHIELD_POPCORNE_RIGHT

config ZMK_SPLIT
    default y

endif
```

## config/shields/popcorne/Kconfig.shield
```kconfig
# No whitespace after the comma or in your part name!
config SHIELD_POPCORNE_LEFT
    def_bool $(shields_list_contains,popcorne_left)

# No whitespace after the comma or in your part name!
config SHIELD_POPCORNE_RIGHT
    def_bool $(shields_list_contains,popcorne_right)
```
